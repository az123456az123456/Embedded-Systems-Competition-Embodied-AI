## 小车代码汇总/代码/2026新开发/rk3588/v143_20261104/ros2/acg138_exploration_20261102/src/deploy/native/br2-external/Config.in
```kconfig
menu "ACG138 ROS 2 overlay (advanced native port)"
source "$BR2_EXTERNAL_ACG138_ROS2_PATH/package/acg138-rplidar/Config.in"
endmenu
```

## 小车代码汇总/代码/2026新开发/rk3588/历史版本/ros_localnav_v50_los_20261103/deploy/native/br2-external/package/acg138-rplidar/Config.in
```kconfig
config BR2_PACKAGE_ACG138_RPLIDAR
	bool "acg138-rplidar (requires preported native ROS)"
	depends on BR2_aarch64
	depends on BR2_INSTALL_LIBSTDCPP
	depends on BR2_TOOLCHAIN_HAS_THREADS
	depends on BR2_TOOLCHAIN_GCC_AT_LEAST_8
	help
	  Builds ONLY this delivery's C1 driver overlay against a separately
	  ported Buildroot-native ROS 2 underlay. This is not a package of
	  ROS 2 core, CycloneDDS or slam_toolbox and does not install them.

if BR2_PACKAGE_ACG138_RPLIDAR
config BR2_PACKAGE_ACG138_RPLIDAR_SOURCE
	string "absolute local acg138_rplidar package source directory"

config BR2_PACKAGE_ACG138_ROS_TARGET_UNDERLAY
	string "same-sysroot ARM64 ROS underlay directory"

config BR2_PACKAGE_ACG138_ROS_HOST_PYTHONPATH
	string "host ament/rosidl Python module path"
	help
	  Host-native code generators, never target Python extensions.
endif
```
